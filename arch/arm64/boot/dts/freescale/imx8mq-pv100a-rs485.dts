/dts-v1/;
/plugin/;

/ {
    compatible = "fsl,imx8mq";

    fragment@0 {
        target-path = "/soc@0/bus@30000000/pinctrl@30330000/uart1grp";
        __overlay__ {
            fsl,pins = <
				0x234 0x49C 0x4F4 0x0 0x0   0x49
				0x238 0x4A0 0x000 0x0 0x0   0x49
				0x244 0x4AC 0x000 0x1 0x0   0x49
				0x248 0x4B0 0x000 0x5 0x0	0x19
			>;
        };
    };

    fragment@1 {
        target-path = "/soc@0/bus@30800000/serial@30860000";
        __overlay__ {
            linux,rs485-enabled-at-boot-time;
            rs485-rts-active-low;
            rts-gpios = <&gpio5 0x1B 0x1>;
        };
    };
};