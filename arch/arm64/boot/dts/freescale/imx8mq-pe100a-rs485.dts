/dts-v1/;
/plugin/;

/ {
    compatible = "fsl,imx8mq";

    fragment@0 {
        target = <&pinctrl_uart2>;
        __overlay__ {
            fsl,pins = <
				0x23C 0x4A4 0x4FC 0x0 0x0   0x49
				0x240 0x4A8 0x000 0x0 0x0   0x49
				0x24C 0x4B4 0x000 0x1 0x0   0x49
				0x250 0x4B8 0x000 0x5 0x0   0x19
			>;
        };
    };

    fragment@1 {
        target = <&uart2>;
        __overlay__ {
            linux,rs485-enabled-at-boot-time;
            rts-gpios = <&gpio5 0x1D 0x1>;
        };
    };
};